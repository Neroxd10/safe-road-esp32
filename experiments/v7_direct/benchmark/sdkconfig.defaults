## experiments/v7_small/main/Kconfig.projbuild
```kconfig
menu "SAFE ROAD OLED and buzzer"
config SAFE_ROAD_OLED_SDA
    int "OLED SDA GPIO"
    default 41
config SAFE_ROAD_OLED_SCL
    int "OLED SCL GPIO"
    default 42
config SAFE_ROAD_BUZZER_GPIO
    int "Buzzer I/O GPIO"
    default 21
config SAFE_ROAD_BUZZER_ACTIVE
    bool "Use active buzzer instead of selected passive module"
    default n
endmenu
```

## main/Kconfig.projbuild
```kconfig
menu "SAFE ROAD OLED and buzzer"
config SAFE_ROAD_OLED_SDA
    int "OLED SDA GPIO"
    default 41
config SAFE_ROAD_OLED_SCL
    int "OLED SCL GPIO"
    default 42
config SAFE_ROAD_BUZZER_GPIO
    int "Buzzer I/O GPIO"
    default 21
config SAFE_ROAD_BUZZER_ACTIVE
    bool "Use active buzzer instead of selected passive module"
    default n
config SAFE_ROAD_BUZZER_FREQUENCY_HZ
    int "Passive buzzer frequency (Hz)"
    depends on !SAFE_ROAD_BUZZER_ACTIVE
    range 1000 5000
    default 2400
    help
        Set the drive frequency to the buzzer's rated resonant frequency
        for the strongest tone.
endmenu
```
